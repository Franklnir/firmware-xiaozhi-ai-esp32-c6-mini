## sdkconfig.defaults.esp32c6
```kconfig
CONFIG_ESPTOOLPY_FLASHSIZE_4MB=y
CONFIG_PARTITION_TABLE_CUSTOM_FILENAME="partitions/v2/4m.csv"
CONFIG_ESPTOOLPY_FLASHMODE_QIO=y

CONFIG_SR_WN_WN9S_ALEXA=y
CONFIG_SR_WN_WN9S_HILEXIN=y
CONFIG_SR_WN_WN9S_HIESP=y
CONFIG_SR_WN_WN9S_NIHAOXIAOZHI=y
CONFIG_SR_WN_WN9S_HIJASON=y

CONFIG_LANGUAGE_EN_US=y
CONFIG_LANGUAGE_ZH_CN=n
```
